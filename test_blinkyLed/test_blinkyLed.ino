/* Copyright 2019, Luccioni Jesus Emanuel
 * All rights reserved.
 */
/** \addtogroup main_c main_c module
 ** @{ */
/********************************[Header File]*************************************//**
 * @file  proyect name
 * @brief proyecto princial
 * @version version
 * @date   dom 30 de junio 2019
 * @note none
 * @par jel
 *************************************************************************************/
/*
 *
 **********************************************************************************************
 *
 * ==========================[ Begin, Add header file ]==========================
 *
 * ******************************************************************************************** */
#include <Arduino.h>
#include "typedef.h"
#include "systick.h"
/**/
#include "ledBlinky.h"
/*
 * **********************************************************************************************
 *
 * ==========================[ End, Add header file ]==========================
 *
 * ******************************************************************************************** */
/*
 *
 **********************************************************************************************
 *
 * ==========================[ Begin, Labels for project config ]==========================
 *
 * ******************************************************************************************** */
#define LED_OK_PIN  12
#define LED_ST_PIN  13

#define TIME_function 5000

/*
 * **********************************************************************************************
 *
 * ==========================[ End, Labels for project config ]==========================
 *
 * ******************************************************************************************** */
/*
 *
 **********************************************************************************************
 *
 * ==========================[ Begin, typedef for project ]==========================
 *
 * ******************************************************************************************** */

/*
 * **********************************************************************************************
 *
 * ==========================[ End, typedef for project ]==========================
 *
 * ******************************************************************************************** */



/*
 *
 **********************************************************************************************
 *
 * ==========================[ Begin, Add Macro Labels ]==========================
 *
 * ******************************************************************************************** */

/* macros labels de encendido y apagado de leds */

/*
 * **********************************************************************************************
 *
 * ==========================[ End, Add Macro Labels ]==========================
 *
 * ******************************************************************************************** */

/*
 *
 **********************************************************************************************
 *
 * ==========================[ Begin, Macro Function ]==========================
 *
 * ******************************************************************************************** */


/*
 * **********************************************************************************************
 *
 * ==========================[ End, Macro Function ]==========================
 *
 * ******************************************************************************************** */
/*
 *
 * *********************************************************************************************
 *
 * ==========================[ begin, local Function declaration ]==========================
 *
 * ******************************************************************************************** */
/*
 * ******************************************************************************//**
 * \fun void function(void);
 * \brief funcion nucleo llamada desde el super loop para cambiar los blink del
 * led bajo test.
 * \return nothing
 * **********************************************************************************/
void function(void);
/*
 *
 **********************************************************************************************
 *
 * ==========================[ End, local Function declaration ]==========================
 *
 * ******************************************************************************************** */
/*
 * ====================================================================================================================
 */
/*
 *
 * **********************************************************************************************
 *
 * ===============================[ Begin, declaracion de variables ]================================
 *
 * ********************************************************************************************
 * todo :declaracion de variables
 *
 * */
uint8_t tick;
ledBlinky_c LedOk(LED_OK_PIN);
#if( __ledBlinky_VERSION__ == 0x01 )
ledBlinky_c LedSt(LED_ST_PIN);
#elif( __ledBlinky_VERSION__ == 0x02 )
ledBlinky_c LedSt(LED_ST_PIN,DISABLE);
#endif


/* **********************************************************************************************
 *
 * ===================================[ End, declaracion de variables ]===================================
 *
 * ********************************************************************************************
 *
 * */
/*
 * ******************************************************************************//**
 * \fun void setup(void)
 * \brief definicion de la funcion principal de configuracion, en la cual nos
 *  encargamos de cofigurar e inicializar todo el hardware y objetos relacionado
 *  al proyecto.
 * \return nothing
 * @note
 * **********************************************************************************/
void setup()
{
  tick = 1;
  LedSt.set(tick);
  LedOk.set(2);
}
/*
 * ******************************************************************************//**
 * \fun void loop(void);
 * \brief definicion de la funcion de super loop, cuerpo del sistema embebido.
 * En el cuerpo de esta debemos colocar todas las funciones que se deben ir
 * actualizando de forma periodica.
 * \return nothing
 * **********************************************************************************/
void loop()
{
  LedSt.update();
  LedOk.update();
  function();
// SLEEP();
}
/*
 * ====================================================================================================================
 */
/*
 * **********************************************************************************************
 *
 * ==========================[ begin, local Function declaration ]==========================
 *
 * **********************************************************************************************
 */
/*
 * **********************************************************************************
 * \fun void function(void);
 * \brief funcion nucleo llamada desde el super loop para cambiar los blink del
 * led bajo test. *
 * \return nothing
 * **********************************************************************************/
void function(void)
{
	static uint_t acu = 0;
	static uint8_t down = 0;

#if( (__systick_VERSION__ >= 0x02 )&& (__systick_VERSION__ != 0x82)  )
	if(systick_nTimeOut_ms(&acu,TIME_function)) return;
#else
	if(!systick_TimeOut_ms(&acu,TIME_function)) return;
#endif
	if(down)
	{
		tick--;
		if(tick == 1) down = 0;
	}
	else
	{
		tick++;
		if(tick == 5) down = 1;
	}
	LedSt.set(tick);
}
/*
 *
 * **********************************************************************************************
 *
 * ==========================[ End, local Function Definition ]==========================
 *
 * ******************************************************************************************** */
